## tina-zero3w/br2-external/Config.in
```kconfig
menu "Zero 3W (A733) board support"

source "$BR2_EXTERNAL_ZERO3W_PATH/package/zero3w-gpu/Config.in"
source "$BR2_EXTERNAL_ZERO3W_PATH/package/zero3w-isp/Config.in"
source "$BR2_EXTERNAL_ZERO3W_PATH/package/zero3w-ocl-icd/Config.in"
source "$BR2_EXTERNAL_ZERO3W_PATH/package/zero3w-firmware/Config.in"
source "$BR2_EXTERNAL_ZERO3W_PATH/package/zero3w-vulkaninfo/Config.in"
source "$BR2_EXTERNAL_ZERO3W_PATH/package/zero3w-native-gcc/Config.in"
source "$BR2_EXTERNAL_ZERO3W_PATH/package/zero3w-npu/Config.in"
source "$BR2_EXTERNAL_ZERO3W_PATH/package/zero3w-bluetooth/Config.in"

endmenu
```

## tina-zero3w/br2-external/package/zero3w-bluetooth/Config.in
```kconfig
config BR2_PACKAGE_ZERO3W_BLUETOOTH
	bool "zero3w-bluetooth (AIC8800 Bluetooth UART bring-up)"
	depends on BR2_aarch64
	depends on BR2_TOOLCHAIN_USES_GLIBC
	depends on BR2_INIT_SYSTEMD
	select BR2_PACKAGE_BLUEZ5_UTILS
	select BR2_PACKAGE_BLUEZ5_UTILS_CLIENT
	help
	  Attaches the AIC8800D80's Bluetooth UART (ttyS1, H4, 1.5 Mbit/s,
	  RTS/CTS) the way the vendor images do: load aic8800_btlpm, wake the
	  controller through /proc/bluetooth/sleep/btwrite, run hciattach_opi
	  with the "aic" init (prebuilt vendor binary from orangepi-build's
	  external/packages/blobs). aic-btaddr then replaces the preset
	  address 10:11:12:13:14:15 that the aic init always programs with
	  the per-chip address from /sys/class/addr_mgt/addr_bt. bluetoothd
	  and bluetoothctl come from bluez5_utils.

comment "zero3w-bluetooth needs an aarch64 glibc toolchain and systemd"
	depends on !BR2_aarch64 || !BR2_TOOLCHAIN_USES_GLIBC || !BR2_INIT_SYSTEMD
```

## tina-zero3w/br2-external/package/zero3w-firmware/Config.in
```kconfig
config BR2_PACKAGE_ZERO3W_FIRMWARE
	bool "zero3w-firmware (aic8800d80 WiFi firmware)"
	help
	  Firmware for the board's AIC8800D80 SDIO WiFi chip, copied at build
	  time from orangepi-build's orangepi-firmware-git cache (the set the
	  working Ubuntu image uses; driver tables request aic8800d80/*).
```

## tina-zero3w/br2-external/package/zero3w-isp/Config.in
```kconfig
config BR2_PACKAGE_ZERO3W_ISP
	bool "zero3w-isp (libAWIspApi/libisp + libcedarc)"
	depends on BR2_aarch64
	depends on BR2_TOOLCHAIN_USES_GLIBC
	help
	  Allwinner closed-source camera ISP and codec userland from the vendor
	  debs (libAWIspApi 602, libcedarc 2.0.0): libAWIspApi.so, libisp.so,
	  libisp_ini.so, AWISPdemo, the cedarc codec libs and /etc/cedarc.conf.
	  Installed into /usr/lib (buildroot has no merged /usr).

comment "zero3w-isp needs an aarch64 glibc toolchain"
	depends on !BR2_aarch64 || !BR2_TOOLCHAIN_USES_GLIBC
```

## tina-zero3w/br2-external/package/zero3w-native-gcc/Config.in
```kconfig
config BR2_PACKAGE_ZERO3W_NATIVE_GCC
	bool "zero3w-native-gcc (on-board C compiler: binutils+gcc+libgcc)"
	depends on BR2_TOOLCHAIN_BUILDROOT_GLIBC
	depends on BR2_TOOLCHAIN_BUILDROOT_CXX
	select BR2_PACKAGE_GMP
	select BR2_PACKAGE_MPFR
	select BR2_PACKAGE_MPC
	help
	  Target-hosted (native) C toolchain for the board, since buildroot
	  removed BR2_PACKAGE_GCC_TARGET long ago.  Builds binutils and gcc
	  (--host=aarch64, C only, no bootstrap, same sources as the internal
	  toolchain) with a private sysroot copy so fixincludes never touches
	  staging, then installs gcc + libgcc + as/ld into /usr and makes the
	  target a usable sysroot (headers, .so linker scripts, .a/.o).
	  Used on the board to compile cltest.c / waitlat.c (acceptance 5/7).
	  This is a slow one-off build (~45-75 min on first run).
```

## tina-zero3w/br2-external/package/zero3w-npu/Config.in
```kconfig
config BR2_PACKAGE_ZERO3W_NPU
	bool "zero3w-npu (VIP NPU userland: libNBGlinker/libVIPhal)"
	depends on BR2_aarch64
	depends on BR2_TOOLCHAIN_USES_GLIBC
	help
	  Allwinner A733 NPU user space from orangepi-build's vendor package
	  cache (sun60iw2_packages/npu): libNBGlinker.so + libVIPhal.so (the
	  whole inference chain on top of the vipcore driver), vip_lite
	  headers, the vendor vpm_run sample in /opt/vpm_run, and npurun
	  (npu-run/ in this repo) in /usr/bin. The yolov5 demo is left out:
	  it is built for another SoC, needs OpenCV 4.5 sonames and crashes.

comment "zero3w-npu needs an aarch64 glibc toolchain"
	depends on !BR2_aarch64 || !BR2_TOOLCHAIN_USES_GLIBC
```

## tina-zero3w/br2-external/package/zero3w-ocl-icd/Config.in
```kconfig
config BR2_PACKAGE_ZERO3W_OCL_ICD
	bool "zero3w-ocl-icd (Khronos OpenCL ICD loader)"
	help
	  libOpenCL.so dispatcher from KhronosGroup/OpenCL-ICD-Loader
	  (v2023.04.17) with OpenCL-Headers installed for on-board gcc.
	  Needed because buildroot 2022.05 predates ocl-icd/opencl-headers
	  (added upstream in 2022.11).  Loads the PowerVR ICD from
	  /etc/OpenCL/vendors/pvr.icd.
```

## tina-zero3w/br2-external/package/zero3w-vulkaninfo/Config.in
```kconfig
config BR2_PACKAGE_ZERO3W_VULKANINFO
	bool "zero3w-vulkaninfo (vulkaninfo against the vendor loader)"
	depends on BR2_PACKAGE_ZERO3W_GPU
	help
	  vulkaninfo from KhronosGroup/Vulkan-Tools (vulkan-sdk-1.3.280.0),
	  cross-compiled against the vendor's libvulkan 1.3.280 (installed by
	  zero3w-gpu into staging).  Used to verify the PowerVR BXM-4-64 ICD
	  (img_icd.json) on the board.
```
